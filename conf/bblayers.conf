## conf/bblayers.conf
```bitbake
# POKY_BBLAYERS_CONF_VERSION is increased each time build/conf/bblayers.conf
# changes incompatibly
POKY_BBLAYERS_CONF_VERSION = "2"

BBPATH = "${TOPDIR}"
BBFILES ?= ""

BBLAYERS ?= " \
  ${TOPDIR}/../../poky/meta \
  ${TOPDIR}/../../poky/meta-poky  \
  ${TOPDIR}/../../poky/meta-yocto-bsp \
  ${TOPDIR}/../../meta-mender/meta-mender-core \
  ${TOPDIR}/../../meta-raspberrypi \
  ${TOPDIR}/../../meta-mender/meta-mender-raspberrypi \
  ${TOPDIR}/../../meta-openembedded/meta-oe \
  ${TOPDIR}/../../meta-openembedded/meta-multimedia \
  ${TOPDIR}/../../meta-openembedded/meta-networking \
  ${TOPDIR}/../../meta-openembedded/meta-python \
  ${TOPDIR}/../../meta-java \
  ${TOPDIR}/../../meta-rtlwifi \
  ${TOPDIR}/../../meta-tessa \
"
```

## conf/local.conf
```bitbake
# Yocto
DISTRO ?= "poky"
PACKAGE_CLASSES ?= "package_rpm"
EXTRA_IMAGE_FEATURES ?= "debug-tweaks"
USER_CLASSES ?= "buildstats image-mklibs image-prelink"
PATCHRESOLVE = "noop"

BB_DISKMON_DIRS ??= "\
    STOPTASKS,${TMPDIR},1G,100K \
    STOPTASKS,${DL_DIR},1G,100K \
    STOPTASKS,${SSTATE_DIR},1G,100K \
    STOPTASKS,/tmp,100M,100K \
    ABORT,${TMPDIR},100M,1K \
    ABORT,${DL_DIR},100M,1K \
    ABORT,${SSTATE_DIR},100M,1K \
    ABORT,/tmp,10M,1K"

CONF_VERSION = "1"

INHERIT += "mender-full"

MACHINE = "raspberrypi-cm3"

ENABLE_BINARY_LOCALE_GENERATION = "1"
GLIBC_GENERATE_LOCALES = "en_US.UTF-8"
IMAGE_LINGUAS = "en-us"

RPI_USE_U_BOOT = "1"
ENABLE_UART = "1"
ENABLE_I2C = "1"

LICENSE_FLAGS_WHITELIST = "commercial"
SANITY_TESTED_DISTROS += " \
            ubuntu-14.04 \n \
            ubuntu-18.04 \n \
            "

# Mender
MENDER_ARTIFACT_NAME = "tensorflow-test"
MENDER_PARTITION_ALIGNMENT = "4194304"
MENDER_BOOT_PART_SIZE_MB = "40"
MENDER_STORAGE_TOTAL_SIZE_MB = "4096"
MENDER_INVENTORY_POLL_INTERVAL_SECONDS="300"
MENDER_RETRY_POLL_INTERVAL_SECONDS="900"
MENDER_UPDATE_POLL_INTERVAL_SECONDS="300"

IMAGE_INSTALL_append = " kernel-image kernel-devicetree openssh tensorflow"
IMAGE_FSTYPES_remove += " rpi-sdimg"

DISTRO_FEATURES_append = " alsa bluetooth bluez5 pulseaudio systemd wifi"
VIRTUAL-RUNTIME_init_manager = "systemd"
DISTRO_FEATURES_BACKFILL_CONSIDERED = "sysvinit"
VIRTUAL-RUNTIME_initscripts = ""

ARTIFACTIMG_FSTYPE = "ext4"
SDIMG_ROOTFS_TYPE = "ext4"
```
